## Software/zmk-model_x_21/boards/shields/model_x/Kconfig.defconfig
```kconfig
if SHIELD_MODEL_X

config ZMK_KEYBOARD_NAME
    default "Model X"

config SPI
    default y

endif
```

## Software/zmk-model_x_23/boards/shields/model_x/Kconfig.defconfig
```kconfig
if SHIELD_MODEL_X

config ZMK_KEYBOARD_NAME
    default "IBM Model M"

config SPI
    default y

endif
```
